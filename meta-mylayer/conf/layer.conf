## meta-mylayer/conf/layer.conf
```bitbake
# We have a conf and classes directory, add to BBPATH
BBPATH .= ":${LAYERDIR}"

# We have recipes-* directories, add to BBFILES
BBFILES += "${LAYERDIR}/recipes-*/*/*.bb \
            ${LAYERDIR}/recipes-*/*/*.bbappend"

BBFILE_COLLECTIONS += "meta-mylayer"
BBFILE_PATTERN_meta-mylayer = "^${LAYERDIR}/"
BBFILE_PRIORITY_meta-mylayer = "6"
LAYERDEPENDS_meta-mylayer = "core"

LAYERDEPENDS_rbimx6ul = " other layers which are present in our source"
LAYERSERIES_COMPAT_meta-mylayer = "hardknott"

# Board related package or features of the image can be appended here
# IMAGE_INSTALL_append = " "
```
